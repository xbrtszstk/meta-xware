## conf/distro/include/sysvinit.inc
```bitbake
# Copyright (c) 2024 Bartosz Szostak
# This software is released under the MIT License.
# See the LICENSE file for more details.

INIT_MANAGER = "sysvinit"
```

## conf/distro/include/x11.inc
```bitbake
# Copyright (c) 2024 Bartosz Szostak
# This software is released under the MIT License.
# See the LICENSE file for more details.

DISTRO_FEATURES:remove = "wayland"
```

## conf/distro/include/xware-glibc-sysvinit-xwayland.inc
```bitbake
# Copyright (c) 2024 Bartosz Szostak
# This software is released under the MIT License.
# See the LICENSE file for more details.

require conf/distro/include/xware.inc
require conf/distro/include/glibc.inc
require conf/distro/include/sysvinit.inc
```

## conf/distro/include/xware.inc
```bitbake
# Copyright (c) 2024 Bartosz Szostak
# This software is released under the MIT License.
# See the LICENSE file for more details.

MAINTAINER = "Bartosz Szostak <bartosz.szostak@xware.pl>"

DISTRO = "xware"
DISTRO_NAME = "xWare Linux"
DISTRO_VERSION = "1.0"
DISTRO_CODENAME = "New Horizons"
DISTRO_FEATURES = "${DISTRO_FEATURES_DEFAULT} opengl ptest multiarch wayland vulkan pam"

SDK_NAME = "${DISTRO}-${TCLIBC}-${SDKMACHINE}-${IMAGE_BASENAME}-${TUNE_PKGARCH}-${MACHINE}"
SDK_VERSION = "${DISTRO_VERSION}"
SDK_VERSION[vardepvalue] = "${SDK_VERSION}"
SDK_VENDOR = "-xwaresdk"
SDKPATHINSTALL = "/opt/${DISTRO}/${SDK_VERSION}"

INHERIT = "buildhistory"
USER_CLASSES = "buildstats buildstats-summary"

TARGET_VENDOR = "-xware"
PACKAGE_CLASSES = "package_rpm"
BUILDHISTORY_COMMIT = "1"

BB_SIGNATURE_HANDLER = "OEEquivHash"
BB_HASHSERVE = "auto"
BB_GIT_SHALLOW = "1"
BB_GIT_SHALLOW_DEPTH = "1"
BB_GENERATE_SHALLOW_TARBALLS = "1"

require conf/distro/include/no-static-libs.inc
require conf/distro/include/security_flags.inc
```

## conf/distro/xware.conf
```bitbake
# Copyright (c) 2024 Bartosz Szostak
# This software is released under the MIT License.
# See the LICENSE file for more details.

XWARE_PROFILE ??= "xware-glibc-systemd-xwayland"

require conf/distro/include/${XWARE_PROFILE}.inc
```

## conf/layer.conf
```bitbake
# We have a conf and classes directory, add to BBPATH
BBPATH .= ":${LAYERDIR}"

# We have recipes-* directories, add to BBFILES
BBFILES += "${LAYERDIR}/recipes-*/*/*.bb \
            ${LAYERDIR}/recipes-*/*/*.bbappend"

BBFILE_COLLECTIONS += "xware-layer"
BBFILE_PATTERN_xware-layer = "^${LAYERDIR}/"
BBFILE_PRIORITY_xware-layer = "6"

LAYERDEPENDS_xware-layer = "core"
LAYERSERIES_COMPAT_xware-layer = "styhead walnascar"
```
